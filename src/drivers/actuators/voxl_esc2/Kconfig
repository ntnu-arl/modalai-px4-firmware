## src/drivers/actuators/voxl_esc2/Kconfig
```kconfig
menuconfig DRIVERS_ACTUATORS_VOXL_ESC2
	bool "voxl_esc2"
	default n
	---help---
		Enable support for voxl_esc2
```

## src/drivers/magnetometer/pca9546/Kconfig
```kconfig
menuconfig DRIVERS_MAGNETOMETER_PCA9546
	bool "PCA9546"
	default n
	---help---
		Enable support for PCA9546
```

## src/drivers/magnetometer/tmag5273/Kconfig
```kconfig
menuconfig DRIVERS_MAGNETOMETER_TMAG5273
	bool "TMAG5273"
	default n
	---help---
		Enable support for TI TMAG5273
```

## src/drivers/magnetometer/tmag5273mult/Kconfig
```kconfig
menuconfig DRIVERS_MAGNETOMETER_TMAG5273MULT
	bool "TMAG5273MULT"
	default n
	---help---
		Enable support for TI TMAG5273MULT
```

## src/drivers/magnetometer/tmag5273mux/Kconfig
```kconfig
menuconfig DRIVERS_MAGNETOMETER_TMAG5273MUX
	bool "TMAG5273MUX"
	default n
	---help---
		Enable support for TI TMAG5273MUX
```

## src/modules/mc_neural_control/Kconfig
```kconfig
menuconfig MODULES_MC_NEURAL_CONTROL
	bool "mc_neural_control"
	default n
	---help---
		Enable support for mc_neural_control

menuconfig USER_MC_NEURAL_CONTROL
	bool "mc_neural_control running as userspace module"
	default n
	depends on BOARD_PROTECTED && MODULES_MC_NEURAL_CONTROL
	---help---
		Put mc_neural_control in userspace memory
```

## src/modules/mc_nn_att_control/Kconfig
```kconfig
menuconfig MODULES_MC_NN_ATT_CONTROL
	bool "mc_nn_att_control"
	default n
	---help---
		Enable support for mc_nn_att_control

menuconfig USER_MC_NN_ATT_CONTROL
	bool "mc_nn_att_control running as userspace module"
	default n
	depends on BOARD_PROTECTED && MODULES_MC_NN_ATT_CONTROL
	---help---
		Put mc_nn_att_control in userspace memory
```

## src/modules/mc_nn_e2e_control/Kconfig
```kconfig
menuconfig MODULES_NN_E2E
	bool "mc_nn_e2e"
	default n
	---help---
		Enable support for mc_nn_end2end

menuconfig USER_MC_NN_E2E
	bool "mc_nn_e2e running as userspace module"
	default n
	depends on BOARD_PROTECTED && MODULES_NN_E2E
	---help---
		Put mc_nn_end2end in userspace memory
```

## src/modules/mc_nn_pos_control/Kconfig
```kconfig
menuconfig MODULES_MC_NN_POS_CONTROL
	bool "mc_nn_pos_control"
	default n
	---help---
		Enable support for mc_nn_pos_control

menuconfig USER_MC_NN_POS_CONTROL
	bool "mc_nn_pos_control running as userspace module"
	default n
	depends on BOARD_PROTECTED && MODULES_NN_POS_CONTROL
	---help---
		Put mc_nn_pos_control in userspace memory
```

## src/modules/mc_safe_control/Kconfig
```kconfig
menuconfig MODULES_MC_SAFE_CONTROL
	bool "mc_safe_control"
	default n
	---help---
		Enable support for mc_safe_control

menuconfig USER_MC_SAFE_CONTROL
	bool "mc_safe_control running as userspace module"
	default n
	depends on BOARD_PROTECTED && MODULES_MC_SAFE_CONTROL
	---help---
		Put mc_safe_control in userspace memory
```

## src/modules/mc_sm_control/Kconfig
```kconfig
menuconfig MODULES_MC_SM_CONTROL
	bool "mc_sm_control"
	default n
	---help---
		Enable support for mc_sm_control

menuconfig USER_MC_SM_CONTROL
	bool "mc_sm_control running as userspace module"
	default n
	depends on BOARD_PROTECTED && MODULES_MC_SM_CONTROL
	---help---
		Put mc_sm_control in userspace memory
```

## src/modules/mc_sm_pos_control/Kconfig
```kconfig
menuconfig MODULES_MC_SM_POS_CONTROL
	bool "mc_sm_pos_control"
	default n
	---help---
		Enable support for mc_sm_pos_control

menuconfig USER_MC_SM_POS_CONTROL
	bool "mc_sm_pos_control running as userspace module"
	default n
	depends on BOARD_PROTECTED && MODULES_MC_SM_POS_CONTROL
	---help---
		Put mc_sm_pos_control in userspace memory
```
