## src/modules/mc_nmpc_control/Kconfig
```kconfig
menuconfig MODULES_MC_NMPC_CONTROL
	bool "mc_nmpc_control"
	default n
	---help---
		Enable support for mc_nmpc_control

menuconfig USER_MC_NMPC_CONTROL
	bool "mc_nmpc_control running as userspace module"
	default n
	depends on BOARD_PROTECTED && MODULES_MC_NMPC_CONTROL
	---help---
		Put mc_nmpc_control in userspace memory
```
